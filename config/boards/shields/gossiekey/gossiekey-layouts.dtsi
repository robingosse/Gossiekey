/ {
    physical_layout0: physical_layout_0 {
        compatible = "zmk,physical-layout";
        kscan = <&kscan0>;
        transform = <&default_transform>;
        rows = <7>;
        columns = <10>;
    };
};