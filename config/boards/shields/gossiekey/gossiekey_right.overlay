/*
    &kscan0 {
        label = "KSCAN";
        matrix-row-count = <7>;
        matrix-col-count = <5>;
        input-gpios = <...>;
        output-gpios = <...>;
        drive-pins;
        diode-direction = "row2col";
        &default_transform {
        col-offset = <5>;
        }
    };
*/

#include "gossiekey.dtsi" // (Your matrix transform file)

&kscan0 {
    col-gpios = <&pro_micro 17 GPIO_ACTIVE_HIGH>,
                <&pro_micro 20 GPIO_ACTIVE_HIGH>,
                <&pro_micro 22 GPIO_ACTIVE_HIGH>,
                <&pro_micro 24 GPIO_ACTIVE_HIGH>,
                <&pro_micro 32 GPIO_ACTIVE_HIGH>;
    row-gpios = <&pro_micro 11 (GPIO_ACTIVE_HIGH | GPIO_PULL_DOWN)>,
                <&pro_micro 36 (GPIO_ACTIVE_HIGH | GPIO_PULL_DOWN)>,
                <&pro_micro 38 (GPIO_ACTIVE_HIGH | GPIO_PULL_DOWN)>,
                <&pro_micro 19 (GPIO_ACTIVE_HIGH | GPIO_PULL_DOWN)>,
                <&pro_micro 21 (GPIO_ACTIVE_HIGH | GPIO_PULL_DOWN)>,
                <&pro_micro 23 (GPIO_ACTIVE_HIGH | GPIO_PULL_DOWN)>,
                <&pro_micro 12 (GPIO_ACTIVE_HIGH | GPIO_PULL_DOWN)>;
};

&default_transform { // Offset of 3 because the left side has 3 columns
    col-offset = <5>;
};
