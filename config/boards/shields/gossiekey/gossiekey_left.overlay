/ {
    kscan0: kscan {
        compatible = "zmk,kscan-gpio-matrix";
        label = "KSCAN";

        row-gpios = <&pro_micro 11 (GPIO_PULL_DOWN | GPIO_ACTIVE_HIGH)>,
                    <&pro_micro 36 (GPIO_PULL_DOWN | GPIO_ACTIVE_HIGH)>,
                    <&pro_micro 38 (GPIO_PULL_DOWN | GPIO_ACTIVE_HIGH)>,
                    <&pro_micro 19 (GPIO_PULL_DOWN | GPIO_ACTIVE_HIGH)>,
                    <&pro_micro 21 (GPIO_PULL_DOWN | GPIO_ACTIVE_HIGH)>,
                    <&pro_micro 23 (GPIO_PULL_DOWN | GPIO_ACTIVE_HIGH)>,
                    <&pro_micro 12 (GPIO_PULL_DOWN | GPIO_ACTIVE_HIGH)>;

        col-gpios = <&pro_micro 17 GPIO_ACTIVE_HIGH>,
                    <&pro_micro 20 GPIO_ACTIVE_HIGH>,
                    <&pro_micro 22 GPIO_ACTIVE_HIGH>,
                    <&pro_micro 24 GPIO_ACTIVE_HIGH>,
                    <&pro_micro 32 GPIO_ACTIVE_HIGH>;

        drive-pins;
        diode-direction = "row2col";
    };
};
