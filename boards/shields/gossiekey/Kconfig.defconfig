## boards/shields/gossiekey/Kconfig.defconfig
```kconfig
if SHIELD_GOSSIEKEY_LEFT

config ZMK_GOSSIEKEY
    string "Shield Name (max 15 chars)"
    default "GOSSIEKEY"

config ZMK_SPLIT_ROLE_CENTRAL
    bool "Enable central role on left half"
    default y

endif

if SHIELD_GOSSIEKEY_LEFT || SHIELD_GOSSIEKEY_RIGHT

config ZMK_SPLIT
    bool "Enable split keyboard"
    default y

endif
```

## boards/shields/gossiekey/Kconfig.shield
```kconfig
# No whitespace after the comma or in your part name!
config SHIELD_GOSSIEKEY_LEFT
    def_bool $(shields_list_contains,gossiekey_left)

# No whitespace after the comma or in your part name!
config SHIELD_GOSSIEKEY_RIGHT
    def_bool $(shields_list_contains,gossiekey_right)
```

## build/Kconfig/Kconfig.modules
```kconfig
menu "nanopb (C:/Users/robin/github/modules/lib/nanopb)"
osource "$(ZEPHYR_NANOPB_KCONFIG)"
config ZEPHYR_NANOPB_MODULE
	bool
	default y
endmenu
menu "acpica (C:/Users/robin/github/modules/lib/acpica)"
osource "$(ZEPHYR_ACPICA_KCONFIG)"
config ZEPHYR_ACPICA_MODULE
	bool
	default y
endmenu
menu "canopennode (C:/Users/robin/github/modules/lib/canopennode)"
osource "$(ZEPHYR_CANOPENNODE_KCONFIG)"
config ZEPHYR_CANOPENNODE_MODULE
	bool
	default y
endmenu
menu "cmsis (C:/Users/robin/github/modules/hal/cmsis)"
osource "$(ZEPHYR_CMSIS_KCONFIG)"
config ZEPHYR_CMSIS_MODULE
	bool
	default y
endmenu
menu "cmsis-dsp (C:/Users/robin/github/modules/lib/cmsis-dsp)"
osource "$(ZEPHYR_CMSIS_DSP_KCONFIG)"
config ZEPHYR_CMSIS_DSP_MODULE
	bool
	default y
endmenu
menu "cmsis-nn (C:/Users/robin/github/modules/lib/cmsis-nn)"
osource "$(ZEPHYR_CMSIS_NN_KCONFIG)"
config ZEPHYR_CMSIS_NN_MODULE
	bool
	default y
endmenu
menu "fatfs (C:/Users/robin/github/modules/fs/fatfs)"
osource "$(ZEPHYR_FATFS_KCONFIG)"
config ZEPHYR_FATFS_MODULE
	bool
	default y
endmenu
menu "hal_ambiq (C:/Users/robin/github/modules/hal/ambiq)"
osource "$(ZEPHYR_HAL_AMBIQ_KCONFIG)"
config ZEPHYR_HAL_AMBIQ_MODULE
	bool
	default y
endmenu
menu "hal_espressif (C:/Users/robin/github/modules/hal/espressif)"
osource "C:/Users/robin/github/modules/hal/espressif/zephyr/Kconfig"
config ZEPHYR_HAL_ESPRESSIF_MODULE
	bool
	default y
endmenu
menu "hal_ethos_u (C:/Users/robin/github/modules/hal/ethos_u)"
osource "$(ZEPHYR_HAL_ETHOS_U_KCONFIG)"
config ZEPHYR_HAL_ETHOS_U_MODULE
	bool
	default y
endmenu
menu "hal_gigadevice (C:/Users/robin/github/modules/hal/gigadevice)"
osource "$(ZEPHYR_HAL_GIGADEVICE_KCONFIG)"
config ZEPHYR_HAL_GIGADEVICE_MODULE
	bool
	default y
endmenu
menu "hal_nordic (C:/Users/robin/github/modules/hal/nordic)"
osource "$(ZEPHYR_HAL_NORDIC_KCONFIG)"
config ZEPHYR_HAL_NORDIC_MODULE
	bool
	default y
endmenu
menu "hal_rpi_pico (C:/Users/robin/github/modules/hal/rpi_pico)"
osource "$(ZEPHYR_HAL_RPI_PICO_KCONFIG)"
config ZEPHYR_HAL_RPI_PICO_MODULE
	bool
	default y
endmenu
menu "hal_telink (C:/Users/robin/github/modules/hal/telink)"
osource "C:/Users/robin/github/modules/hal/telink/Kconfig"
config ZEPHYR_HAL_TELINK_MODULE
	bool
	default y
endmenu
menu "liblc3 (C:/Users/robin/github/modules/lib/liblc3)"
osource "$(ZEPHYR_LIBLC3_KCONFIG)"
config ZEPHYR_LIBLC3_MODULE
	bool
	default y
endmenu
menu "littlefs (C:/Users/robin/github/modules/fs/littlefs)"
osource "$(ZEPHYR_LITTLEFS_KCONFIG)"
config ZEPHYR_LITTLEFS_MODULE
	bool
	default y
endmenu
menu "lvgl (C:/Users/robin/github/modules/lib/gui/lvgl)"
osource "C:/Users/robin/github/modules/lib/gui/lvgl/Kconfig"
config ZEPHYR_LVGL_MODULE
	bool
	default y
endmenu
menu "mbedtls (C:/Users/robin/github/modules/crypto/mbedtls)"
osource "$(ZEPHYR_MBEDTLS_KCONFIG)"
config ZEPHYR_MBEDTLS_MODULE
	bool
	default y
endmenu
menu "percepio (C:/Users/robin/github/modules/debug/percepio)"
osource "C:/Users/robin/github/modules/debug/percepio/zephyr/Kconfig"
config ZEPHYR_PERCEPIO_MODULE
	bool
	default y
endmenu
menu "picolibc (C:/Users/robin/github/modules/lib/picolibc)"
osource "C:/Users/robin/github/modules/lib/picolibc/zephyr/Kconfig"
config ZEPHYR_PICOLIBC_MODULE
	bool
	default y
endmenu
menu "segger (C:/Users/robin/github/modules/debug/segger)"
osource "$(ZEPHYR_SEGGER_KCONFIG)"
config ZEPHYR_SEGGER_MODULE
	bool
	default y
endmenu
menu "trusted-firmware-a (C:/Users/robin/github/modules/tee/tf-a/trusted-firmware-a)"
osource "$(ZEPHYR_TRUSTED_FIRMWARE_A_KCONFIG)"
config ZEPHYR_TRUSTED_FIRMWARE_A_MODULE
	bool
	default y
endmenu
menu "uoscore-uedhoc (C:/Users/robin/github/modules/lib/uoscore-uedhoc)"
osource "$(ZEPHYR_UOSCORE_UEDHOC_KCONFIG)"
config ZEPHYR_UOSCORE_UEDHOC_MODULE
	bool
	default y
endmenu
menu "zcbor (C:/Users/robin/github/modules/lib/zcbor)"
osource "$(ZEPHYR_ZCBOR_KCONFIG)"
config ZEPHYR_ZCBOR_MODULE
	bool
	default y
endmenu
menu "module (C:/Users/robin/github/zmk/app/module)"
osource "C:/Users/robin/github/zmk/app/module/Kconfig"
config ZEPHYR_MODULE_MODULE
	bool
	default y
endmenu
```

## config/Kconfig
```kconfig
# SPDX-License-Identifier: MIT

if SHIELD_GOSSIEKEY

config SHIELD_GOSSIEKEY
    bool "GossieKey Split Keyboard"
    depends on SHIELD
    select ZMK_KEYBOARD_SPLIT
    select ZMK_KSCAN_MATRIX

endif
```

## keyboard/west.yml
```yaml
manifest:
  defaults:
    remote: zmkfirmware

  remotes:
    - name: zmkfirmware
      url-base: https://github.com/zmkfirmware
    - name: myfork
      url-base: https://github.com/robingosse  # ← Change this to your GitHub username

  projects:
    - name: nanopb
      remote: myfork
      revision: nanopb  # ← Replace with your fork branch, e.g., "main" or "module-fix"
      path: modules/lib/nanopb    # ← Use the same path ZMK expects

    - name: zephyr
      remote: zmkfirmware
      revision: main
      import:
        name-allowlist:
          - cmsis
          - hal_nordic
          - hal_st
          - hal_stm32
          - mbedtls
          - net-tools
          - segger
          - tinycbor

    - name: zmk
      remote: zmkfirmware
      revision: main
      import: app/west.yml

  self:
    path: .
```
