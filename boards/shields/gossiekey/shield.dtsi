/ {
    compatible = "zmk,matrix-transform";
    // Define the number of rows and columns in your matrix
    // 7 switches × 5 directions = 35 logical keys
    // ZMK can scan these using `input-matrix`
};

&matrix {
    compatible = "zmk,matrix-transform";
    row-gpios = < 
        &gpio0 11 GPIO_ACTIVE_LOW  /* SW1 */
        &gpio1 4  GPIO_ACTIVE_LOW  /* SW2 */
        &gpio1 6  GPIO_ACTIVE_LOW  /* SW3 */
        &gpio0 19 GPIO_ACTIVE_LOW  /* SW4 */
        &gpio0 21 GPIO_ACTIVE_LOW  /* SW5 */
        &gpio0 23 GPIO_ACTIVE_LOW  /* SW6 */
        &gpio0 12 GPIO_ACTIVE_LOW  /* SW7 */
    >;

    col-gpios = <
        &gpio0 17 GPIO_ACTIVE_LOW  /* Red - North */
        &gpio0 20 GPIO_ACTIVE_LOW  /* Yellow - South */
        &gpio0 22 GPIO_ACTIVE_LOW  /* Blue - East */
        &gpio0 24 GPIO_ACTIVE_LOW  /* Green - West */
        &gpio1 0  GPIO_ACTIVE_LOW  /* Black - Center */
    >;
};
